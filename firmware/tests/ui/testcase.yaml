## west-manifest/west.yml
```yaml
manifest:
  version: 0.13

  remotes:
    - name: zephyrproject-rtos
      url-base: https://github.com/zephyrproject-rtos

  projects:
    - name: zephyr
      remote: zephyrproject-rtos
      revision: v3.6.0
      import:
        name-allowlist:
          - cmsis
          - hal_nordic
          - segger

  self:
    path: west-manifest
```
