## CMakeLists.txt
```
cmake_minimum_required(VERSION 3.20)

find_package(Zephyr REQUIRED HINTS $ENV{ZEPHYR_BASE})
project(nokia_ui)

target_sources(app PRIVATE
    src/main.c
    src/ui_framework.c
    src/screens.c
    src/game_snake.c
    src/applet_messages.c
)

target_sources_ifdef(CONFIG_NOKIA_BACKEND_SH1107_I2C app PRIVATE
    src/display.c
    src/display_transform.c
    src/display_sh1107.c
)

target_sources_ifdef(CONFIG_NOKIA_KEYPAD_MCP23008 app PRIVATE
    src/keypad_mcp23008.c
)
```

## Kconfig
```
mainmenu "Nokia UI Application"

source "Kconfig.zephyr"

menu "LCD Profile"

config NOKIA_LCD_WIDTH
	int "LCD width in pixels"
	default 84
	help
	  Framebuffer width matching the physical display.
	  Override per-display via an overlay .conf, e.g.:
	    west build -- -DOVERLAY_CONFIG=firmware/app/lcd_profiles/sh1107_128.conf

config NOKIA_LCD_HEIGHT
	int "LCD height in pixels"
	default 48
	help
	  Framebuffer height matching the physical display.

endmenu

menu "Backend"

choice NOKIA_BACKEND
	prompt "Display backend"
	default NOKIA_BACKEND_SIM

config NOKIA_BACKEND_SIM
	bool "Simulation (Renode)"
	help
	  nokia_fb lives in RAM; the Renode/Python simulator reads it directly.
	  No I2C driver is compiled in.  Use this for all simulator builds.

config NOKIA_BACKEND_SH1107_I2C
	bool "SH1107 over I2C (real hardware)"
	select I2C
	help
	  Initialises the SH1107 display over I2C and flushes nokia_fb to it
	  every ui_tick().  Targets the GME128128-01-IIC (v2.0) and compatible
	  128x128 SH1107 modules.

endchoice

config NOKIA_SH1107_I2C_ADDR
	hex "SH1107 I2C address"
	default 0x3C
	depends on NOKIA_BACKEND_SH1107_I2C
	help
	  7-bit I2C address of the display. Most boards use 0x3C; some use 0x3D.

config NOKIA_DISPLAY_ROTATION
	int "Display rotation (degrees)"
	default 0
	range 0 270
	depends on NOKIA_BACKEND_SH1107_I2C
	help
	  Rotate the framebuffer before sending to the display.
	  Valid values: 0, 90, 180, 270 (clockwise).

config NOKIA_DISPLAY_VFLIP
	bool "Flip display vertically"
	default n
	depends on NOKIA_BACKEND_SH1107_I2C
	help
	  Invert the vertical axis after rotation.  Enable this when the
	  display shows the correct landscape orientation but top and bottom
	  are swapped (e.g. status bar appears at bottom instead of top).

config NOKIA_SH1107_SEG_REMAP
	bool "SH1107 segment remap (0xA1)"
	default n
	depends on NOKIA_BACKEND_SH1107_I2C
	help
	  Enable reversed segment addressing (0xA1 instead of 0xA0).
	  Use when the display panel is wired with SEG reversed.

config NOKIA_SH1107_COM_REMAP
	bool "SH1107 COM output remap (0xC8)"
	default n
	depends on NOKIA_BACKEND_SH1107_I2C
	help
	  Enable reversed COM output scan direction (0xC8 instead of 0xC0).
	  Use when the display panel is wired with COM scan reversed.

endmenu

menu "Keypad"

config NOKIA_KEYPAD_MCP23008
	bool "4×4 matrix keypad via MCP23008 I²C expander"
	depends on NOKIA_BACKEND_SH1107_I2C
	select I2C
	help
	  Enables the MCP23008 GPIO-expander keypad driver.
	  GP0–GP3 are row outputs; GP4–GP7 are column inputs with pull-ups.
	  Matches the "4x4_mcp23008" keypad profile in lcd_viewer.py.

config NOKIA_MCP23008_I2C_ADDR
	hex "MCP23008 I2C address (7-bit)"
	default 0x20
	depends on NOKIA_KEYPAD_MCP23008
	help
	  7-bit I2C address of the MCP23008.  Set by hardware pins A0–A2:
	  all low → 0x20, A0 high → 0x21, etc.

config NOKIA_KEYPAD_ROTATION
	int "Keypad rotation (degrees clockwise)"
	default 0
	range 0 270
	depends on NOKIA_KEYPAD_MCP23008
	help
	  Rotate the directional keys clockwise.  Valid values: 0, 90, 180, 270.
	  Use this when the keypad PCB is mounted at an angle relative to the
	  display.  Only affects UP/DOWN/LEFT/RIGHT — OK is unchanged.

endmenu
```

## prj.conf
```kconfig
CONFIG_PRINTK=y
CONFIG_SERIAL=y
CONFIG_UART_CONSOLE=y

CONFIG_NEWLIB_LIBC=y

CONFIG_MAIN_STACK_SIZE=4096
CONFIG_SYSTEM_WORKQUEUE_STACK_SIZE=2048
```

## src/main.c
```c
#include <zephyr/kernel.h>
#include <zephyr/sys/printk.h>
#include "ui_framework.h"
#include "display.h"
#ifdef CONFIG_NOKIA_KEYPAD_MCP23008
#include "keypad_mcp23008.h"
#endif
#ifdef CONFIG_USB_DEVICE_STACK
#include <zephyr/usb/usb_device.h>
#include <zephyr/drivers/uart.h>
#endif

/*
 * Memory-mapped button state.
 * Write one of the KEY_* values (see ui_framework.h) here from Renode /
 * Python to simulate a key press.  The main loop consumes and clears it.
 *
 * Example from Python / Renode monitor:
 *   sysbus.WriteByteToAddress(nokia_keys_raw_address, 0x01)  # KEY_LEFT
 */
__attribute__((used))
volatile uint8_t nokia_keys_raw;

/*
 * Character key input for text entry (e.g. SMS/T9).
 * lcd_viewer.py writes the ASCII code of the pressed key (0-9, *, #).
 * Cleared by the consumer after reading.  Unused until SMS is implemented.
 */
__attribute__((used))
volatile uint8_t nokia_char_raw;

/* Defined in screens.c */
extern const screen_def_t g_screens[];
extern const int          g_screen_count;

int main(void)
{
#ifdef CONFIG_USB_DEVICE_STACK
    /* Enable USB and wait up to 3 s for a host terminal (DTR).
     * The board continues normally if nobody connects. */
    usb_enable(NULL);
    const struct device *cdc = DEVICE_DT_GET(DT_CHOSEN(zephyr_console));
    if (device_is_ready(cdc)) {
        uint32_t dtr = 0;
        for (int i = 0; i < 30 && !dtr; i++) {
            uart_line_ctrl_get(cdc, UART_LINE_CTRL_DTR, &dtr);
            k_sleep(K_MSEC(100));
        }
    }
#endif

    printk("Nokia3310 UI starting...\n");

    if (display_init() != 0) {
        printk("Warning: display init failed, continuing anyway\n");
    }

#ifdef CONFIG_NOKIA_KEYPAD_MCP23008
    if (keypad_mcp23008_init() != 0) {
        printk("Warning: keypad init failed, hardware keys disabled\n");
    }
#endif

    ui_init(g_screens, g_screen_count, 0);

    while (1) {
        uint8_t k = nokia_keys_raw;
        if (k) {
            nokia_keys_raw = 0;
            ui_inject_key((nokia_key_t)k);
        }

#ifdef CONFIG_NOKIA_KEYPAD_MCP23008
        nokia_key_t hw_key = keypad_mcp23008_poll();
        if (hw_key != KEY_NONE) {
            ui_inject_key(hw_key);
        }
#endif

        ui_tick();
        display_flush();
        k_sleep(K_MSEC(5));
    }

    return 0;
}
```

## src/applet_messages.c
```c
/*
 * Nokia 3310 Messages Applet  -  T9 multi-tap text entry
 *
 * States
 * ------
 *   MS_INBOX    -  scrollable inbox with 3 pre-filled messages
 *   MS_VIEW     -  full-screen message reader
 *   MS_COMPOSE  -  text compose with T9 multi-tap input
 *   MS_SENT     -  "Message sent!" confirmation (auto-dismisses)
 *
 * T9 key map (multi-tap  -  same key cycles through characters)
 * -----------------------------------------------------------
 *   0: " 0"    1: ".,!?"   2: "abc"   3: "def"
 *   4: "ghi"   5: "jkl"    6: "mno"   7: "pqrs"
 *   8: "tuv"   9: "wxyz"
 *   *   -  toggle uppercase / lowercase (commits pending char first)
 *   #   -  insert space (commits pending char first)
 *
 * Key bindings
 * ------------
 *   Inbox:   UP/DOWN scroll, OK = view, LEFT SK = New, RIGHT SK = Back
 *   View:    any key = back to inbox
 *   Compose: digit/star/hash keys via nokia_char_raw (T9 input)
 *            LEFT SK  = backspace / cancel (empty -> back to inbox)
 *            RIGHT SK = Send
 *            OK       = commit pending T9 char
 *   Sent:    any key = back to inbox (also auto-dismisses after 1.5 s)
 */

#include "ui_framework.h"
#include "applet_messages.h"

#include <stdbool.h>
#include <stdint.h>
#include <string.h>
#include <stdio.h>

/* Character key input written by lcd_viewer.py */
extern volatile uint8_t nokia_char_raw;

/* ------------------------------------------------------------------ */
/* Constants                                                            */
/* ------------------------------------------------------------------ */
#define MSG_MAX_LEN      64        /* max chars in compose buffer      */
#define CHARS_PER_LINE   (NOKIA_LCD_WIDTH / UI_CHAR_W)
#define T9_TIMEOUT       8         /* ticks before pending char commits */
#define INBOX_COUNT      3
#define SENT_HOLD_TICKS  15        /* auto-dismiss "Sent!" after 1.5 s  */

/* Vertical layout (scaled) */
#define TITLE_Y          _UY(1)
#define HLINE_Y          (_UY(1) + UI_CHAR_H)
#define CONTENT_Y        (HLINE_Y + _UY(3))
#define CONTENT_ROW_H    (UI_CHAR_H + 1)
#define SK_HLINE_Y       UI_SOFTKEY_SEP_Y
#define SK_TEXT_Y        UI_SOFTKEY_TEXT_Y

/* ------------------------------------------------------------------ */
/* T9 character map                                                     */
/* ------------------------------------------------------------------ */
static const char * const T9_CHARS[10] = {
    " 0",    /* 0 */
    ".,!?",  /* 1 */
    "abc",   /* 2 */
    "def",   /* 3 */
    "ghi",   /* 4 */
    "jkl",   /* 5 */
    "mno",   /* 6 */
    "pqrs",  /* 7 */
    "tuv",   /* 8 */
    "wxyz",  /* 9 */
};

/* ------------------------------------------------------------------ */
/* Pre-filled inbox messages                                            */
/* ------------------------------------------------------------------ */
static const char * const INBOX_FROM[INBOX_COUNT] = {
    "Alice", "Bob", "Mom"
};

static const char * const INBOX_TEXT[INBOX_COUNT] = {
    "Coming tonight?",
    "Check the news",
    "Call me pls",
};

/* ------------------------------------------------------------------ */
/* State                                                                */
/* ------------------------------------------------------------------ */
typedef enum { MS_INBOX, MS_VIEW, MS_COMPOSE, MS_SENT } msg_state_t;

static msg_state_t state;
static int8_t      inbox_cursor;   /* 0 .. INBOX_COUNT-1               */
static int8_t      view_idx;       /* message currently being read      */

/* Compose text buffer */
static char    compose_buf[MSG_MAX_LEN + 1];
static int     compose_len;

/* T9 input state */
static int8_t  t9_key;     /* current key index (0-9), -1 = none       */
static uint8_t t9_tap;     /* how many times the key has been pressed   */
static uint8_t t9_timer;   /* ticks elapsed since last tap              */
static bool    t9_upper;   /* uppercase mode flag                       */

/* UI helpers */
static uint8_t blink_ticks;   /* drives cursor blink (bit 2 used)       */
static uint8_t sent_ticks;    /* countdown for MS_SENT auto-dismiss      */

/* ------------------------------------------------------------------ */
/* T9 helpers                                                           */
/* ------------------------------------------------------------------ */
static char t9_pending_char(void)
{
    if (t9_key < 0) return '\0';
    const char *s = T9_CHARS[(uint8_t)t9_key];
    int   len = (int)strlen(s);
    char  c   = s[t9_tap % (unsigned)len];
    if (t9_upper && c >= 'a' && c <= 'z') c = (char)(c - 32);
    return c;
}

static void t9_commit(void)
{
    if (t9_key < 0) return;
    char c = t9_pending_char();
    if (c && compose_len < MSG_MAX_LEN) {
        compose_buf[compose_len++] = c;
        compose_buf[compose_len]   = '\0';
    }
    t9_key   = -1;
    t9_tap   = 0;
    t9_timer = 0;
}

static void t9_handle(uint8_t ascii_ch)
{
    if (ascii_ch == '*') {          /* toggle case; commit first         */
        t9_commit();
        t9_upper = !t9_upper;
        return;
    }
    if (ascii_ch == '#') {          /* insert space; commit first        */
        t9_commit();
        if (compose_len < MSG_MAX_LEN) {
            compose_buf[compose_len++] = ' ';
            compose_buf[compose_len]   = '\0';
        }
        return;
    }
    if (ascii_ch < '0' || ascii_ch > '9') return;

    int key = ascii_ch - '0';
    if (t9_key == (int8_t)key) {    /* same key: advance cycle           */
        t9_tap++;
        t9_timer = 0;
    } else {                        /* different key: commit + start new */
        t9_commit();
        t9_key   = (int8_t)key;
        t9_tap   = 0;
        t9_timer = 0;
    }
}

static void compose_reset(void)
{
    compose_len    = 0;
    compose_buf[0] = '\0';
    t9_key         = -1;
    t9_tap         = 0;
    t9_timer       = 0;
    t9_upper       = true;  /* Nokia default: start uppercase */
}

/* ------------------------------------------------------------------ */
/* Drawing helpers                                                      */
/* ------------------------------------------------------------------ */
static void draw_title(const char *title)
{
    int len = (int)strlen(title);
    int x   = (NOKIA_LCD_WIDTH - len * UI_CHAR_W) / 2;
    if (x < 0) x = 0;
    ui_fb_text(x, TITLE_Y, title);
    ui_fb_hline(HLINE_Y, 0, NOKIA_LCD_WIDTH - 1);
}

static void draw_softkeys(const char *left_sk, const char *right_sk)
{
    ui_fb_hline(SK_HLINE_Y, 0, NOKIA_LCD_WIDTH - 1);
    if (left_sk  && *left_sk)  ui_fb_text(1, SK_TEXT_Y, left_sk);
    if (right_sk && *right_sk) {
        int rx = NOKIA_LCD_WIDTH - (int)strlen(right_sk) * UI_CHAR_W - 1;
        if (rx < 0) rx = 0;
        ui_fb_text(rx, SK_TEXT_Y, right_sk);
    }
}

/* Render one inbox row; selected rows are inverted */
static void draw_inbox_row(int idx, int y, bool selected)
{
    char line[22]; /* enough for widest display (128/6=21 chars) */
    snprintf(line, sizeof(line), "%s: %s", INBOX_FROM[idx], INBOX_TEXT[idx]);

    if (selected) {
        ui_fb_rect(0, y - 1, NOKIA_LCD_WIDTH, CONTENT_ROW_H);
        ui_fb_text_inv(0, y, line);
    } else {
        ui_fb_text(2, y, line);
    }
}

/* ------------------------------------------------------------------ */
/* Applet callbacks                                                     */
/* ------------------------------------------------------------------ */
static void msg_init(void)
{
    state        = MS_INBOX;
    inbox_cursor = 0;
    view_idx     = 0;
    blink_ticks  = 0;
    sent_ticks   = 0;
    compose_reset();
    nokia_char_raw = 0;  /* discard any stale key press */
}

static void msg_tick(void)
{
    blink_ticks++;

    /* Consume character key from lcd_viewer (T9 input) */
    uint8_t ch = nokia_char_raw;
    if (ch) {
        nokia_char_raw = 0;
        if (state == MS_COMPOSE) {
            t9_handle(ch);
        }
    }

    /* T9 timeout: auto-commit if no tap for T9_TIMEOUT ticks */
    if (state == MS_COMPOSE && t9_key >= 0) {
        if (++t9_timer >= T9_TIMEOUT) {
            t9_commit();
        }
    }

    /* Auto-dismiss the "Sent!" screen */
    if (state == MS_SENT && ++sent_ticks >= SENT_HOLD_TICKS) {
        state = MS_INBOX;
    }
}

static void msg_render(void)
{
    ui_fb_clear();

    switch (state) {

    /* ---------------------------------------------------------------- */
    case MS_INBOX:
        draw_title("Messages");
        for (int i = 0; i < INBOX_COUNT; i++) {
            draw_inbox_row(i, CONTENT_Y + i * CONTENT_ROW_H,
                           i == inbox_cursor);
        }
        draw_softkeys("NEW", "BACK");
        break;

    /* ---------------------------------------------------------------- */
    case MS_VIEW: {
        draw_title(INBOX_FROM[view_idx]);
        /* Render message text, wrapping at CHARS_PER_LINE */
        const char *text = INBOX_TEXT[view_idx];
        int         pos  = 0;
        int         line = 0;
        int         tlen = (int)strlen(text);
        int         max_lines = (SK_HLINE_Y - CONTENT_Y) / CONTENT_ROW_H;
        while (pos < tlen && line < max_lines) {
            char   row[22];
            int    n = tlen - pos;
            if (n > CHARS_PER_LINE) n = CHARS_PER_LINE;
            if (n > (int)sizeof(row) - 1) n = (int)sizeof(row) - 1;
            memcpy(row, text + pos, n);
            row[n] = '\0';
            ui_fb_text(0, CONTENT_Y + line * CONTENT_ROW_H, row);
            pos  += n;
            line++;
        }
        draw_softkeys("", "BACK");
        break;
    }

    /* ---------------------------------------------------------------- */
    case MS_COMPOSE: {
        /* Title shows current case mode */
        draw_title(t9_upper ? "Write Msg [A]" : "Write Msg [a]");

        /*
         * Display visible lines of the compose buffer.
         * The cursor always sits on cursor_line; scroll so it stays visible.
         */
        int max_lines   = (SK_HLINE_Y - CONTENT_Y) / CONTENT_ROW_H;
        int cursor_line = compose_len / CHARS_PER_LINE;
        int start_line  = (cursor_line >= max_lines) ? (cursor_line - max_lines + 1) : 0;

        for (int row = 0; row < max_lines; row++) {
            int src  = start_line + row;
            int y    = CONTENT_Y + row * CONTENT_ROW_H;
            int coff = src * CHARS_PER_LINE;  /* char offset for this line */

            if (coff > compose_len) break;

            /* Characters already committed on this line */
            int n = compose_len - coff;
            if (n > CHARS_PER_LINE) n = CHARS_PER_LINE;

            if (n > 0) {
                char seg[CHARS_PER_LINE + 1];
                memcpy(seg, compose_buf + coff, n);
                seg[n] = '\0';
                ui_fb_text(0, y, seg);
            }

            /* Cursor / pending T9 char  -  only on the active line */
            if (src == cursor_line) {
                int cx = n * UI_CHAR_W;
                if (cx > NOKIA_LCD_WIDTH - UI_CHAR_W) cx = NOKIA_LCD_WIDTH - UI_CHAR_W;

                if (t9_key >= 0) {
                    /* Pending char: fill cell, then draw inverted */
                    ui_fb_rect(cx, y - 1, UI_CHAR_W, CONTENT_ROW_H);
                    char pending[2] = { t9_pending_char(), '\0' };
                    ui_fb_text_inv(cx, y, pending);
                } else {
                    /* Blinking underscore cursor (toggles every 4 ticks) */
                    if ((blink_ticks >> 2) & 1) {
                        ui_fb_hline(y + UI_CHAR_H - 1, cx, cx + UI_CHAR_W - 2);
                    }
                }
            }
        }

        draw_softkeys("DEL", "SEND");
        break;
    }

    /* ---------------------------------------------------------------- */
    case MS_SENT:
        draw_title("Messages");
        /* Centred confirmation banner */
        ui_fb_rect(0, _UY(18), NOKIA_LCD_WIDTH, CONTENT_ROW_H + 2);
        ui_fb_text_inv(_UX(3), _UY(20), "  Message sent!  ");
        draw_softkeys("", "OK");
        break;
    }
}

static void msg_on_key(nokia_key_t key)
{
    switch (state) {

    case MS_INBOX:
        switch (key) {
        case KEY_UP:    if (inbox_cursor > 0) inbox_cursor--;            break;
        case KEY_DOWN:  if (inbox_cursor < INBOX_COUNT - 1) inbox_cursor++; break;
        case KEY_OK:    view_idx = inbox_cursor; state = MS_VIEW;        break;
        case KEY_LEFT:  compose_reset(); state = MS_COMPOSE;             break;
        case KEY_RIGHT: ui_back();                                        break;
        default:        break;
        }
        break;

    case MS_VIEW:
        /* Any nav key returns to inbox */
        state = MS_INBOX;
        break;

    case MS_COMPOSE:
        switch (key) {
        case KEY_RIGHT:
            /* SEND  -  commit any pending T9 char, then go to Sent screen */
            t9_commit();
            sent_ticks = 0;
            state      = MS_SENT;
            break;
        case KEY_LEFT:
            /* DEL / Cancel */
            if (t9_key >= 0) {
                /* cancel pending T9 char without committing */
                t9_key   = -1;
                t9_tap   = 0;
                t9_timer = 0;
            } else if (compose_len > 0) {
                compose_buf[--compose_len] = '\0';
            } else {
                state = MS_INBOX;
            }
            break;
        case KEY_OK:
            /* Commit current pending T9 char */
            t9_commit();
            break;
        default:
            break;
        }
        break;

    case MS_SENT:
        state = MS_INBOX;
        break;
    }
}

/* ------------------------------------------------------------------ */
/* Exported applet descriptor                                           */
/* ------------------------------------------------------------------ */
const applet_t messages_applet = {
    .init   = msg_init,
    .tick   = msg_tick,
    .render = msg_render,
    .on_key = msg_on_key,
};
```

## src/applet_messages.h
```c
#pragma once
#include "ui_framework.h"

extern const applet_t messages_applet;
```

## src/display.c
```c
#include "display.h"
#include "display_sh1107.h"

#ifdef CONFIG_NOKIA_BACKEND_SH1107_I2C

#include <stdbool.h>
#include <zephyr/kernel.h>
#include <zephyr/drivers/gpio.h>
#include <zephyr/drivers/i2c.h>
#include <zephyr/sys/printk.h>

#include "display_transform.h"
#include "ui_framework.h"

static const struct gpio_dt_spec leds[] = {
    GPIO_DT_SPEC_GET(DT_ALIAS(led0), gpios),
    GPIO_DT_SPEC_GET(DT_ALIAS(led1), gpios),
    GPIO_DT_SPEC_GET(DT_ALIAS(led2), gpios),
};

static bool display_ready;

static void led_set(int idx, bool on)
{
    if (device_is_ready(leds[idx].port)) {
        gpio_pin_set_dt(&leds[idx], on ? 1 : 0);
    }
}

static void led_init_all(void)
{
    for (int i = 0; i < 3; i++) {
        if (device_is_ready(leds[i].port)) {
            gpio_pin_configure_dt(&leds[i], GPIO_OUTPUT_INACTIVE);
        }
    }
}

static bool display_is_ready(void)
{
    return display_ready;
}

int display_init(void)
{
    led_init_all();

    for (int i = 0; i < 3; i++) {
        led_set(i, true);
    }
    k_sleep(K_MSEC(300));
    for (int i = 0; i < 3; i++) {
        led_set(i, false);
    }
    k_sleep(K_MSEC(200));

    int ret = sh1107_hw_init();
    if (ret == 0) {
        display_ready = true;
        led_set(1, true);  /* green = OK */
        return 0;
    }

    display_ready = false;
    printk("display: init failed (%d)\n", ret);

    if (ret == -ENOENT) {
        /* Nothing on bus — rapid red × 10 */
        for (int i = 0; i < 10; i++) {
            led_set(0, true);  k_sleep(K_MSEC(100));
            led_set(0, false); k_sleep(K_MSEC(100));
        }
    } else if (ret == -ENXIO) {
        /* Bus has devices but no SH1107 — red × 6 */
        for (int i = 0; i < 6; i++) {
            led_set(0, true);  k_sleep(K_MSEC(150));
            led_set(0, false); k_sleep(K_MSEC(150));
        }
    }
    led_set(0, true);   /* red = failed */
    return ret;
}

void display_flush(void)
{
    if (!display_is_ready()) {
        return;
    }

    static bool hb;
    static int err_count;
    uint8_t buf[NOKIA_LCD_WIDTH];

    hb = !hb;
    led_set(2, hb);

    for (int page = 0; page < NOKIA_LCD_PAGES; page++) {
        int ret;

        display_transform_page(page, buf);
        ret = sh1107_write_page(page, buf);
        if (ret) {
            err_count++;
            printk("display: page %d failed (%d) [%d]\n",
                   page, ret, err_count);

            /* Try to unstick the bus */
            const struct device *bus = DEVICE_DT_GET(DT_NODELABEL(i2c1));
            i2c_recover_bus(bus);
            k_sleep(K_MSEC(5));

            if (err_count >= 20) {
                display_ready = false;
                led_set(1, false);
                led_set(0, true);
                printk("display: too many errors, disabling\n");
            }
            return;
        }
    }
    err_count = 0;
}

#endif
```

## src/display.h
```c
#pragma once

/*
 * Unified display interface.
 * Works for SH1107 I2C hardware and simulator (no-ops for sim).
 */
#ifdef CONFIG_NOKIA_BACKEND_SH1107_I2C
int display_init(void);
void display_flush(void);
#else
static inline int display_init(void)
{
    return 0;
}

static inline void display_flush(void)
{
}
#endif
```

## src/display_sh1107.c
```c
#include "display_sh1107.h"

#ifdef CONFIG_NOKIA_BACKEND_SH1107_I2C

#include <zephyr/kernel.h>
#include <zephyr/drivers/i2c.h>
#include <zephyr/sys/printk.h>
#include <string.h>

#include "ui_framework.h"

#define CTRL_CMD_STREAM  0x00
#define CTRL_DATA_STREAM 0x40

static const struct device *i2c_dev;
static uint8_t sh1107_addr;

static int sh1107_cmds(const uint8_t *cmds, size_t len)
{
    uint8_t buf[32];

    if (len + 1 > sizeof(buf)) {
        return -EINVAL;
    }

    buf[0] = CTRL_CMD_STREAM;
    memcpy(&buf[1], cmds, len);
    return i2c_write(i2c_dev, buf, len + 1, sh1107_addr);
}

static int sh1107_probe(uint8_t addr)
{
    uint8_t dummy;

    return i2c_read(i2c_dev, &dummy, 1, addr);
}

static void sh1107_fill(uint8_t byte)
{
    for (int page = 0; page < NOKIA_LCD_PAGES; page++) {
        uint8_t addr_cmds[] = { 0xB0 | (uint8_t)page, 0x00, 0x10 };
        uint8_t buf[1 + NOKIA_LCD_WIDTH];

        sh1107_cmds(addr_cmds, sizeof(addr_cmds));
        buf[0] = CTRL_DATA_STREAM;
        memset(&buf[1], byte, NOKIA_LCD_WIDTH);
        i2c_write(i2c_dev, buf, sizeof(buf), sh1107_addr);
    }
}

int sh1107_hw_init(void)
{
    i2c_dev = DEVICE_DT_GET(DT_NODELABEL(i2c1));
    if (!device_is_ready(i2c_dev)) {
        printk("display_sh1107: I2C bus not ready\n");
        return -ENODEV;
    }

    printk("display_sh1107: I2C scan...\n");
    int found_count = 0;
    for (uint8_t addr = 0x08; addr <= 0x77; addr++) {
        if (sh1107_probe(addr) == 0) {
            found_count++;
            printk("  found device at 0x%02X\n", addr);
        }
    }
    if (found_count == 0) {
        printk("  no devices found — check wiring\n");
        return -ENOENT;   /* nothing on bus */
    }

    const uint8_t candidates[] = {
        CONFIG_NOKIA_SH1107_I2C_ADDR,
        CONFIG_NOKIA_SH1107_I2C_ADDR ^ 0x01,
    };

    sh1107_addr = 0;
    for (size_t i = 0; i < ARRAY_SIZE(candidates); i++) {
        if (sh1107_probe(candidates[i]) == 0) {
            sh1107_addr = candidates[i];
            printk("display_sh1107: SH1107 found at 0x%02X\n", sh1107_addr);
            break;
        }
    }
    if (sh1107_addr == 0) {
        printk("display_sh1107: no SH1107 at 0x%02X or 0x%02X — check wiring\n",
               CONFIG_NOKIA_SH1107_I2C_ADDR,
               CONFIG_NOKIA_SH1107_I2C_ADDR ^ 0x01);
        return -ENXIO;    /* bus has devices but not SH1107 at expected address */
    }

    static const uint8_t init_seq[] = {
        0xAE,
        0xDC, 0x00,
        0x81, 0x8F,
#if CONFIG_NOKIA_SH1107_SEG_REMAP
        0xA1,
#else
        0xA0,
#endif
#if CONFIG_NOKIA_SH1107_COM_REMAP
        0xC8,
#else
        0xC0,
#endif
        0xA4,
        0xA6,
        0xA8, 0x7F,
        0xD3, 0x00,
        0xD5, 0x51,
        0xD9, 0x22,
        0xDB, 0x35,
        0xAD, 0x8A,
    };
    static const uint8_t display_on[] = { 0xAF };

    int ret = sh1107_cmds(init_seq, sizeof(init_seq));
    if (ret) {
        printk("display_sh1107: init failed (%d)\n", ret);
        return ret;
    }

    k_sleep(K_MSEC(100));

    ret = sh1107_cmds(display_on, sizeof(display_on));
    if (ret) {
        printk("display_sh1107: display-on failed (%d)\n", ret);
        return ret;
    }

    sh1107_fill(0xFF);
    k_sleep(K_MSEC(1000));
    sh1107_fill(0x00);

    printk("display_sh1107: SH1107 ready\n");
    return 0;
}

int sh1107_write_page(int page, const uint8_t *buf)
{
    uint8_t tx[1 + NOKIA_LCD_WIDTH];
    uint8_t addr_cmds[] = { 0xB0 | (uint8_t)page, 0x00, 0x10 };
    int ret;

    if (page < 0 || page >= NOKIA_LCD_PAGES || buf == NULL || sh1107_addr == 0) {
        return -EINVAL;
    }

    ret = sh1107_cmds(addr_cmds, sizeof(addr_cmds));
    if (ret) {
        return ret;
    }

    tx[0] = CTRL_DATA_STREAM;
    memcpy(&tx[1], buf, NOKIA_LCD_WIDTH);
    return i2c_write(i2c_dev, tx, sizeof(tx), sh1107_addr);
}

#endif
```

## src/display_sh1107.h
```c
#pragma once

#include <stdint.h>

/*
 * Pure SH1107 I2C protocol layer.
 * No rotation, no framebuffer logic.
 */
int sh1107_hw_init(void);
int sh1107_write_page(int page, const uint8_t *buf);
```

## src/display_transform.c
```c
#include "display_transform.h"

#include <string.h>

#include "ui_framework.h"

void display_transform_page(int page, uint8_t *buf)
{
    if (page < 0 || page >= NOKIA_LCD_PAGES) {
        memset(buf, 0, NOKIA_LCD_WIDTH);
        return;
    }

#if CONFIG_NOKIA_DISPLAY_ROTATION == 0 && !CONFIG_NOKIA_DISPLAY_VFLIP
    memcpy(buf, nokia_fb[page], NOKIA_LCD_WIDTH);

#elif CONFIG_NOKIA_DISPLAY_ROTATION == 270
    /*
     * Optimised 270° rotation for square (128×128) display.
     * Output page P, column dx gets pixel from fb at:
     *   src_x = NOKIA_LCD_HEIGHT - 1 - (page*8 + bit)
     *   src_y = dx
     * Rewritten to avoid per-pixel function calls.
     */
    for (int dx = 0; dx < NOKIA_LCD_WIDTH; dx++) {
        uint8_t byte = 0;
        int src_y = dx;
        int src_page = src_y >> 3;
        int src_bit  = src_y & 7;
        uint8_t src_mask = (uint8_t)(1u << src_bit);

        for (int bit = 0; bit < 8; bit++) {
            int src_x = NOKIA_LCD_HEIGHT - 1 - (page * 8 + bit);
#if CONFIG_NOKIA_DISPLAY_VFLIP
            src_x = NOKIA_LCD_HEIGHT - 1 - src_x;
#endif
            if ((unsigned)src_x < (unsigned)NOKIA_LCD_WIDTH &&
                (nokia_fb[src_page][src_x] & src_mask)) {
                byte |= (uint8_t)(1u << bit);
            }
        }
        buf[dx] = byte;
    }

#elif CONFIG_NOKIA_DISPLAY_ROTATION == 90
    for (int dx = 0; dx < NOKIA_LCD_WIDTH; dx++) {
        uint8_t byte = 0;
        int src_y = NOKIA_LCD_HEIGHT - 1 - dx;
        int src_page = src_y >> 3;
        int src_bit  = src_y & 7;
        uint8_t src_mask = (uint8_t)(1u << src_bit);

        for (int bit = 0; bit < 8; bit++) {
            int src_x = page * 8 + bit;
#if CONFIG_NOKIA_DISPLAY_VFLIP
            src_x = NOKIA_LCD_HEIGHT - 1 - src_x;
#endif
            if ((unsigned)src_x < (unsigned)NOKIA_LCD_WIDTH &&
                (nokia_fb[src_page][src_x] & src_mask)) {
                byte |= (uint8_t)(1u << bit);
            }
        }
        buf[dx] = byte;
    }

#elif CONFIG_NOKIA_DISPLAY_ROTATION == 180
    for (int dx = 0; dx < NOKIA_LCD_WIDTH; dx++) {
        uint8_t byte = 0;
        for (int bit = 0; bit < 8; bit++) {
            int src_x = NOKIA_LCD_WIDTH - 1 - dx;
            int src_y = NOKIA_LCD_HEIGHT - 1 - (page * 8 + bit);
#if CONFIG_NOKIA_DISPLAY_VFLIP
            src_y = NOKIA_LCD_HEIGHT - 1 - src_y;
#endif
            int sp = src_y >> 3;
            if ((nokia_fb[sp][src_x] >> (src_y & 7)) & 1) {
                byte |= (uint8_t)(1u << bit);
            }
        }
        buf[dx] = byte;
    }

#else
    /* rotation == 0 with vflip */
    int src_page = NOKIA_LCD_PAGES - 1 - page;
    for (int dx = 0; dx < NOKIA_LCD_WIDTH; dx++) {
        uint8_t s = nokia_fb[src_page][dx];
        /* reverse bits within the byte */
        uint8_t r = 0;
        r |= (s & 0x01) << 7; r |= (s & 0x02) << 5;
        r |= (s & 0x04) << 3; r |= (s & 0x08) << 1;
        r |= (s & 0x10) >> 1; r |= (s & 0x20) >> 3;
        r |= (s & 0x40) >> 5; r |= (s & 0x80) >> 7;
        buf[dx] = r;
    }
#endif
}
```

## src/display_transform.h
```c
#pragma once

#include <stdint.h>

/*
 * Fill buf[NOKIA_LCD_WIDTH] with the transformed pixel data for the given
 * display page (0 .. NOKIA_LCD_PAGES-1), reading from nokia_fb and applying
 * CONFIG_NOKIA_DISPLAY_ROTATION and CONFIG_NOKIA_DISPLAY_VFLIP.
 */
void display_transform_page(int page, uint8_t *buf);
```

## src/game_snake.c
```c
/*
 * Nokia 3310 Snake
 *
 * Architecture: implements the applet_t interface so the UI framework
 * can treat it like any other screen on the navigation stack.  The
 * framework calls init() once on entry, tick()+render() every 100 ms,
 * and on_key() for every keypress.  Calling ui_back() from on_key()
 * pops Snake off the stack and returns to the previous screen.
 *
 * Grid: 21 × 10 cells at CELL=4 px each.
 * Layout:
 *   y = 0–6   score header ("SNAKE" left, score right)
 *   y = 7     divider
 *   y = 8–47  game area (10 rows × 21 columns)
 *
 * Controls (during play):
 *   UP / DOWN / LEFT / RIGHT  — steer
 *   OK                        — pause / unpause
 * Controls (paused or game-over):
 *   OK                        — resume / restart
 *   RIGHT                     — exit to menu
 */

#include "ui_framework.h"
#include "game_snake.h"

#include <stdbool.h>
#include <stdint.h>
#include <string.h>
#include <stdio.h>

/* ------------------------------------------------------------------ */
/* Grid geometry                                                        */
/* ------------------------------------------------------------------ */
#define CELL          (4 * UI_FONT_SCALE)            /* pixels per cell */
#define GW            (NOKIA_LCD_WIDTH  / CELL)      /* columns         */
#define GH            ((NOKIA_LCD_HEIGHT - _UY(8)) / CELL) /* rows     */
#define GAME_Y        _UY(8)                         /* top of game area */
#define SNAKE_MAX     55                             /* max snake length */
#define INITIAL_SPEED 2                              /* ticks per move   */

/* ------------------------------------------------------------------ */
/* State                                                                */
/* ------------------------------------------------------------------ */
typedef struct { int8_t x, y; } pt_t;

static pt_t     g_body[SNAKE_MAX];  /* [0] = tail,  [len-1] = head */
static int      g_len;
static int8_t   g_dx, g_dy;        /* current direction            */
static pt_t     g_food;
static int      g_score;
static bool     g_game_over;
static bool     g_paused;
static int      g_ticks;           /* frame counter                */
static int      g_speed;           /* ticks between snake moves    */
static uint8_t  g_game_count;      /* seeds RNG differently each game */
static uint16_t g_rng;

/* ------------------------------------------------------------------ */
/* RNG — xorshift16                                                     */
/* ------------------------------------------------------------------ */
static uint16_t rng_next(void)
{
    g_rng ^= (uint16_t)(g_rng << 7);
    g_rng ^= (uint16_t)(g_rng >> 9);
    g_rng ^= (uint16_t)(g_rng << 8);
    return g_rng;
}

/* ------------------------------------------------------------------ */
/* Helpers                                                              */
/* ------------------------------------------------------------------ */
static bool is_snake(int x, int y)
{
    for (int i = 0; i < g_len; i++) {
        if (g_body[i].x == x && g_body[i].y == y) return true;
    }
    return false;
}

static void place_food(void)
{
    pt_t f;
    int  tries = 0;
    do {
        f.x = (int8_t)(rng_next() % GW);
        f.y = (int8_t)(rng_next() % GH);
        tries++;
    } while (is_snake(f.x, f.y) && tries < GW * GH);
    g_food = f;
}

/* ------------------------------------------------------------------ */
/* Reset — also used as the applet init()                               */
/* ------------------------------------------------------------------ */
static void snake_reset(void)
{
    /* Different seed each game */
    g_rng = (uint16_t)(1 + g_game_count++);

    g_len = 3;
    g_dx  = 1;
    g_dy  = 0;

    /* Start horizontally in the middle-left of the grid */
    for (int i = 0; i < g_len; i++) {
        g_body[i].x = (int8_t)i;
        g_body[i].y = (int8_t)(GH / 2);
    }

    g_score     = 0;
    g_speed     = INITIAL_SPEED;
    g_ticks     = 0;
    g_game_over = false;
    g_paused    = false;

    place_food();
}

/* ------------------------------------------------------------------ */
/* Move snake one cell in the current direction                         */
/* ------------------------------------------------------------------ */
static void snake_move(void)
{
    pt_t head = {
        (int8_t)(g_body[g_len - 1].x + g_dx),
        (int8_t)(g_body[g_len - 1].y + g_dy)
    };

    /* Wall collision */
    if (head.x < 0 || head.x >= GW || head.y < 0 || head.y >= GH) {
        g_game_over = true;
        return;
    }

    /* Self collision — skip tail (index 0) which moves away this tick */
    for (int i = 1; i < g_len; i++) {
        if (g_body[i].x == head.x && g_body[i].y == head.y) {
            g_game_over = true;
            return;
        }
    }

    bool ate = (head.x == g_food.x && head.y == g_food.y);

    if (!ate) {
        /* Drop tail: shift body left by one */
        memmove(g_body, g_body + 1, (size_t)(g_len - 1) * sizeof(pt_t));
        g_len--;
    }

    /* Append new head */
    if (g_len < SNAKE_MAX) {
        g_body[g_len++] = head;
    }

    if (ate) {
        g_score++;
        /* Speed up every 3 food items, cap at 1 tick/move */
        g_speed = INITIAL_SPEED - g_score / 5;
        if (g_speed < 1) g_speed = 1;
        place_food();
    }
}

/* ------------------------------------------------------------------ */
/* Applet tick — update state only, no drawing                          */
/* ------------------------------------------------------------------ */
static void snake_tick(void)
{
    if (g_game_over || g_paused) return;
    if (++g_ticks % g_speed == 0) {
        snake_move();
    }
}

/* ------------------------------------------------------------------ */
/* Applet render — write to nokia_fb                                    */
/* ------------------------------------------------------------------ */
static void snake_render(void)
{
    ui_fb_clear();

    if (g_game_over) {
        char buf[16];
        snprintf(buf, sizeof(buf), "SCORE: %d", g_score);
        ui_fb_text_inv(_UX(15), _UY(3),  "  GAME OVER  ");
        ui_fb_text(_UX(17),     _UY(15), buf);
        ui_fb_text(_UX(1),      _UY(28), "OK:replay");
        ui_fb_text(_UX(1),      _UY(37), "RIGHT:menu");
        return;
    }

    /* Score header */
    {
        char buf[8];
        snprintf(buf, sizeof(buf), "%d", g_score);
        ui_fb_text(0, 0, "SNAKE");
        int sx = NOKIA_LCD_WIDTH - (int)strlen(buf) * UI_CHAR_W;
        if (sx > 0) ui_fb_text(sx, 0, buf);
    }

    /* Divider */
    ui_fb_hline(GAME_Y - 1, 0, NOKIA_LCD_WIDTH - 1);

    /* Food — small dot centred in its cell */
    int food_sz = CELL / 2;
    int food_off = (CELL - food_sz) / 2;
    ui_fb_rect(g_food.x * CELL + food_off,
               GAME_Y + g_food.y * CELL + food_off,
               food_sz, food_sz);

    /* Snake body — blocks with 1 px gap; head is solid full cell */
    for (int i = 0; i < g_len - 1; i++) {
        ui_fb_rect(g_body[i].x * CELL,
                   GAME_Y + g_body[i].y * CELL,
                   CELL - 1, CELL - 1);
    }
    if (g_len > 0) {
        int i = g_len - 1;
        ui_fb_rect(g_body[i].x * CELL,
                   GAME_Y + g_body[i].y * CELL,
                   CELL, CELL);
    }

    /* Pause overlay */
    if (g_paused) {
        ui_fb_text_inv(_UX(25), _UY(19), " PAUSE ");
        ui_fb_text(_UX(1), _UY(28), "OK:resume");
        ui_fb_text(_UX(1), _UY(37), "RIGHT:menu");
    }
}

/* ------------------------------------------------------------------ */
/* Applet key handler                                                   */
/* ------------------------------------------------------------------ */
static void snake_on_key(nokia_key_t key)
{
    if (g_game_over) {
        if (key == KEY_OK)    { snake_reset(); return; }
        if (key == KEY_RIGHT) { ui_back();     return; }
        return;
    }

    if (g_paused) {
        if (key == KEY_OK)    { g_paused = false; return; }
        if (key == KEY_RIGHT) { ui_back();         return; }
        return;
    }

    switch (key) {
    /* Steer — 180° reversals are blocked */
    case KEY_UP:    if (g_dy == 0) { g_dx =  0; g_dy = -1; } break;
    case KEY_DOWN:  if (g_dy == 0) { g_dx =  0; g_dy =  1; } break;
    case KEY_LEFT:  if (g_dx == 0) { g_dx = -1; g_dy =  0; } break;
    case KEY_RIGHT: if (g_dx == 0) { g_dx =  1; g_dy =  0; } break;
    case KEY_OK:    g_paused = true; break;
    default: break;
    }
}

/* ------------------------------------------------------------------ */
/* Exported applet descriptor                                           */
/* ------------------------------------------------------------------ */
const applet_t snake_applet = {
    .init   = snake_reset,
    .tick   = snake_tick,
    .render = snake_render,
    .on_key = snake_on_key,
};
```

## src/game_snake.h
```c
/*
 * Nokia 3310 Snake — applet descriptor
 *
 * Register in screens.c with:
 *   [SCR_SNAKE] = APPLET_SCREEN("Snake", &snake_applet),
 */
#pragma once
#include "ui_framework.h"

extern const applet_t snake_applet;
```

## src/keypad_mcp23008.c
```c
#include "keypad_mcp23008.h"

#ifdef CONFIG_NOKIA_KEYPAD_MCP23008

#include <zephyr/kernel.h>
#include <zephyr/drivers/i2c.h>
#include <zephyr/sys/printk.h>

/* MCP23008 register addresses */
#define MCP_IODIR   0x00   /* I/O direction: 1 = input, 0 = output     */
#define MCP_GPPU    0x06   /* Pull-up resistors: 1 = enabled            */
#define MCP_GPIO    0x09   /* GPIO port register (read)                 */
#define MCP_OLAT    0x0A   /* Output latch (write)                      */

/*
 * GP0–GP3  row outputs  (active-LOW scan)
 * GP4–GP7  column inputs (pull-ups enabled, LOW when button pressed)
 */
#define MCP_IODIR_VALUE  0xF0   /* lower nibble = output, upper = input */
#define MCP_GPPU_VALUE   0xF0   /* enable pull-ups on column inputs      */
#define MCP_ROWS_IDLE    0x0F   /* all row outputs HIGH (idle)           */

/*
 * Matrix layout — matches lcd_viewer.py "4x4_mcp23008" profile:
 *
 *        COL0    COL1    COL2    COL3
 * ROW0 [  '1'    '2'↑    '3'    'A'◄ ]
 * ROW1 [ '4'←   '5'●   '6'→   'B'►  ]
 * ROW2 [  '7'   '8'↓    '9'    'C'   ]
 * ROW3 [  '*'    '0'    '#'    'D'   ]
 *
 * Navigation mapping (matches simulator nav_char_map):
 *   '2'(0,1) → KEY_UP      '8'(2,1) → KEY_DOWN
 *   '4'(1,0) → KEY_LEFT    '6'(1,2) → KEY_RIGHT
 *   '5'(1,1) → KEY_OK
 *   'A'(0,3) → KEY_LEFT    'B'(1,3) → KEY_RIGHT  (softkey shortcuts)
 */
static const nokia_key_t KEY_MAP[4][4] = {
    { KEY_NONE, KEY_UP,    KEY_NONE,  KEY_LEFT  },  /* row 0: 1  2  3  A */
    { KEY_LEFT, KEY_OK,    KEY_RIGHT, KEY_RIGHT },  /* row 1: 4  5  6  B */
    { KEY_NONE, KEY_DOWN,  KEY_NONE,  KEY_NONE  },  /* row 2: 7  8  9  C */
    { KEY_NONE, KEY_NONE,  KEY_NONE,  KEY_NONE  },  /* row 3: *  0  #  D */
};

static const struct device *mcp_i2c;
static uint8_t              mcp_addr;
static uint16_t             prev_pressed; /* bitmask of last-known pressed keys */

static nokia_key_t rotate_key(nokia_key_t k)
{
#if CONFIG_NOKIA_KEYPAD_ROTATION == 90
    switch (k) {
    case KEY_UP:    return KEY_RIGHT;
    case KEY_RIGHT: return KEY_DOWN;
    case KEY_DOWN:  return KEY_LEFT;
    case KEY_LEFT:  return KEY_UP;
    default:        return k;
    }
#elif CONFIG_NOKIA_KEYPAD_ROTATION == 180
    switch (k) {
    case KEY_UP:    return KEY_DOWN;
    case KEY_DOWN:  return KEY_UP;
    case KEY_LEFT:  return KEY_RIGHT;
    case KEY_RIGHT: return KEY_LEFT;
    default:        return k;
    }
#elif CONFIG_NOKIA_KEYPAD_ROTATION == 270
    switch (k) {
    case KEY_UP:    return KEY_LEFT;
    case KEY_LEFT:  return KEY_DOWN;
    case KEY_DOWN:  return KEY_RIGHT;
    case KEY_RIGHT: return KEY_UP;
    default:        return k;
    }
#else
    return k;
#endif
}

static int mcp_write_reg(uint8_t reg, uint8_t val)
{
    uint8_t buf[2] = { reg, val };

    return i2c_write(mcp_i2c, buf, sizeof(buf), mcp_addr);
}

static int mcp_read_gpio(uint8_t *out)
{
    return i2c_write_read(mcp_i2c, mcp_addr, &(uint8_t){MCP_GPIO}, 1, out, 1);
}

int keypad_mcp23008_init(void)
{
    mcp_i2c  = DEVICE_DT_GET(DT_NODELABEL(i2c1));
    mcp_addr = CONFIG_NOKIA_MCP23008_I2C_ADDR;

    if (!device_is_ready(mcp_i2c)) {
        printk("keypad_mcp23008: I2C bus not ready\n");
        return -ENODEV;
    }

    /* Verify the chip responds */
    uint8_t dummy;
    if (i2c_read(mcp_i2c, &dummy, 1, mcp_addr) != 0) {
        printk("keypad_mcp23008: MCP23008 not found at 0x%02X\n", mcp_addr);
        return -ENODEV;
    }

    int ret;

    ret = mcp_write_reg(MCP_IODIR, MCP_IODIR_VALUE);
    if (ret) { printk("keypad_mcp23008: IODIR write failed (%d)\n", ret); return ret; }

    ret = mcp_write_reg(MCP_GPPU, MCP_GPPU_VALUE);
    if (ret) { printk("keypad_mcp23008: GPPU write failed (%d)\n", ret); return ret; }

    ret = mcp_write_reg(MCP_OLAT, MCP_ROWS_IDLE);
    if (ret) { printk("keypad_mcp23008: OLAT write failed (%d)\n", ret); return ret; }

    prev_pressed = 0;
    printk("keypad_mcp23008: MCP23008 ready at 0x%02X\n", mcp_addr);
    return 0;
}

nokia_key_t keypad_mcp23008_poll(void)
{
    /*
     * Optimised scan: drive all rows LOW at once, read columns.
     * If any column is pressed, do per-row scan to identify which key.
     * This reduces I2C traffic from 9 transactions to 2 in the idle case.
     */
    uint8_t gpio_val = 0;

    /* Drive all rows LOW */
    if (mcp_write_reg(MCP_OLAT, 0x00) != 0) {
        return KEY_NONE;
    }

    k_busy_wait(50);

    if (mcp_read_gpio(&gpio_val) != 0) {
        mcp_write_reg(MCP_OLAT, MCP_ROWS_IDLE);
        return KEY_NONE;
    }

    uint8_t any_col = (~gpio_val >> 4) & 0x0F;

    if (any_col == 0) {
        /* No key pressed — restore idle and return early */
        mcp_write_reg(MCP_OLAT, MCP_ROWS_IDLE);
        prev_pressed = 0;
        return KEY_NONE;
    }

    /* At least one key is pressed — do per-row scan */
    uint16_t    now_pressed = 0;
    nokia_key_t first_new   = KEY_NONE;

    for (int r = 0; r < 4; r++) {
        uint8_t olat = MCP_ROWS_IDLE & ~(uint8_t)(1u << r);

        if (mcp_write_reg(MCP_OLAT, olat) != 0) {
            continue;
        }

        k_busy_wait(50);

        gpio_val = 0;
        if (mcp_read_gpio(&gpio_val) != 0) {
            continue;
        }

        uint8_t cols = (~gpio_val >> 4) & 0x0F;

        for (int c = 0; c < 4; c++) {
            if (cols & (1u << c)) {
                uint16_t bit = (uint16_t)(1u << (r * 4 + c));
                now_pressed |= bit;

                if (first_new == KEY_NONE && !(prev_pressed & bit)) {
                    nokia_key_t k = KEY_MAP[r][c];
                    if (k != KEY_NONE) {
                        first_new = k;
                    }
                }
            }
        }
    }

    mcp_write_reg(MCP_OLAT, MCP_ROWS_IDLE);

    prev_pressed = now_pressed;

    first_new = rotate_key(first_new);

    if (first_new != KEY_NONE) {
        static const char * const key_names[] = {
            [KEY_NONE]  = "NONE",
            [KEY_LEFT]  = "LEFT",
            [KEY_RIGHT] = "RIGHT",
            [KEY_UP]    = "UP",
            [KEY_DOWN]  = "DOWN",
            [KEY_OK]    = "OK",
        };
        printk("keypad: %s\n", key_names[first_new]);
    }

    return first_new;
}

#endif /* CONFIG_NOKIA_KEYPAD_MCP23008 */
```

## src/keypad_mcp23008.h
```c
/*
 * 4×4 matrix keypad driver via MCP23008 I²C GPIO expander.
 *
 * Wiring (default):
 *   GP0–GP3 : rows    (output, driven LOW one at a time)
 *   GP4–GP7 : columns (input,  internal pull-ups enabled)
 *
 * Call keypad_mcp23008_init() once at startup.
 * Call keypad_mcp23008_poll() every main-loop tick to get the current key.
 * Returns KEY_NONE when no navigation key is pressed.
 */
#pragma once

#ifdef CONFIG_NOKIA_KEYPAD_MCP23008

#include "ui_framework.h"

int          keypad_mcp23008_init(void);
nokia_key_t  keypad_mcp23008_poll(void);

#endif /* CONFIG_NOKIA_KEYPAD_MCP23008 */
```
